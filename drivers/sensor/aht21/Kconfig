## drivers/sensor/aht21/Kconfig
```kconfig
# AHT21 Digital Humidity and Temperature Sensor

# Copyright (c) 2023 Russ Webber
# SPDX-License-Identifier: Apache-2.0

config AHT21
	bool "AHT21 Digital Humidity and Temperature Sensor"
	default y
	depends on DT_HAS_AOSONG_AHT21_ENABLED
	select I2C
	help
	  Enable driver for AHT21 Digital Humidity and Temperature Sensor.
```

## drivers/sensor/ens160/Kconfig
```kconfig
# ENS160 Digital Metal-Oxide Multi-Gas Sensor configuration options

# Copyright (c) 2023 Russ Webber.
# SPDX-License-Identifier: Apache-2.0

menuconfig ENS160
	bool "ENS160 Digital Metal-Oxide Multi-Gas Sensor"
	default y
	depends on DT_HAS_AMS_ENS160_ENABLED
	select I2C
	help
	  Enable driver for ENS160 Digital Metal-Oxide Multi-Gas Sensor.
if ENS160

config ENS160_CRC_CHECK
	bool "CRC Check"
	default y
	help
	  Check the CRC value after data reading.

config ENS160_MAX_READ_RETRIES
	int "Number of value reading retries"
	default 4
	help
	  Number of retries when value reading failed, value not valid
	  or CRC not ok.

config ENS160_CALIBRATION_SET_RATE
	int "Time in milliseconds between calibration fetching and setting"
	default 3500
	help
	  Time in milliseconds

endif # ENS160
```

## dts/bindings/sensor/ams,ens160.yaml
```yaml
# Copyright (c) 2022, Russ Webber
# SPDX-License-Identifier: Apache-2.0

description: |
    AMS (Austria Mikro Systeme) ENS160 Digital Metal-Oxide Multi-Gas Sensor

compatible: "ams,ens160"

include: [sensor-device.yaml, i2c-device.yaml]

on-bus: i2c

properties:
  humidity-source:
    type: phandle
    required: false
    description: |
      Sensor and sensor channel that will have the humidity calibration values fetched from.

  temperature-source:
    type: phandle
    required: false
    description: |
      Sensor and sensor channel that will have the temperature calibration values fetched from.
```

## dts/bindings/sensor/aosong,aht21.yaml
```yaml
# Copyright (c) 2022 Russ Webber
# SPDX-License-Identifier: Apache-2.0

description: Aosong AHT21 Digital Humidity and Temperature Sensor

compatible: "aosong,aht21"

include: [sensor-device.yaml, i2c-device.yaml]

on-bus: i2c
```
